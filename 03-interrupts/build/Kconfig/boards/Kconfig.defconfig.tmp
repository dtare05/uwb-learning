## 03-interrupts/build/Kconfig/boards/Kconfig.defconfig.tmp
```kconfig
# Load Zephyr board defconfig descriptions.
osource "/opt/nordic/ncs/v3.3.1/zephyr/boards/qorvo/decawave_dwm3001cdk/Kconfig.defconfig"
```

## build/blinky/Kconfig/boards/Kconfig.tmp
```kconfig
# Load Zephyr board Kconfig descriptions.
osource "/opt/nordic/ncs/v3.3.1/zephyr/boards/qorvo/decawave_dwm3001cdk/Kconfig"
```
